## conf/layer.conf
```bitbake
BBPATH .= ":${LAYERDIR}"
BBFILES += "${LAYERDIR}/recipes*/*/*.bb ${LAYERDIR}/recipes*/*/*.bbappend"
BBFILE_COLLECTIONS += "meta-aravis"
BBFILE_PATTERN_meta-aravis := "^${LAYERDIR}/"
BBFILE_PRIORITY_meta-aravis = "90"
```
